#include "screen.h"

#include "i2c.h"
#include "stm32f1xx_hal.h"

#include <stdbool.h>
#include <string.h>

#define I2C_PORT      hi2c1
#define I2C_ADDR      (0x3C << 1)
#define FONT_WIDTH    16
#define FONT_HEIGHT   32
#define SMALL_WIDTH   8
#define SMALL_HEIGHT  14
#define SCREEN_WIDTH  128
#define SCREEN_HEIGHT 32
#define BUFFER_SIZE   (SCREEN_WIDTH * SCREEN_HEIGHT / 8)

// Big glyphs fill the screen height; small (unit) glyphs share their
// baseline. 26/12 are the baseline rows inside the generated font tables.
#define BIG_TOP_Y     (SCREEN_HEIGHT - FONT_HEIGHT)
#define BIG_BASELINE_Y  (BIG_TOP_Y + 26)
#define SMALL_TOP_Y     (BIG_BASELINE_Y - 12)

static uint8_t frame_buffer[BUFFER_SIZE];

// What is currently on the screen, for the change-detected flush in
// screen_show_value(): empty strings mean nothing painted yet.
static char on_screen_value[8];
static char on_screen_unit[5];

// clang-format off
static const uint16_t font[] = {
  0x0000,0x0000,0x0000,0x0000,0x0000,0x0000,0x0000,0x0000,0x0000,0x0000,0x0000,0x0000,0x0000,0x0000,0x0000,0x0000,0x0000,0x0000,0x0000,0x0000,0x0000,0x0000,0x0000,0x0000,0x0000,0x0000,0x0000,0x0000,0x0000,0x0000,0x0000,0x0000, // Ascii = [ ]
  0x0000,0x0000,0x0000,0x0000,0x0000,0x0000,0x0380,0x0380,0x0380,0x0380,0x0380,0x0380,0x0380,0x0380,0x0380,0x0380,0x0380,0x0380,0x0380,0x0000,0x0000,0x0000,0x0380,0x0380,0x0380,0x0380,0x0000,0x0000,0x0000,0x0000,0x0000,0x0000, // Ascii = [!]
  0x0000,0x0000,0x0000,0x0000,0x1C70,0x1C70,0x1C70,0x1C70,0x1C70,0x1C70,0x0000,0x0000,0x0000,0x0000,0x0000,0x0000,0x0000,0x0000,0x0000,0x0000,0x0000,0x0000,0x0000,0x0000,0x0000,0x0000,0x0000,0x0000,0x0000,0x0000,0x0000,0x0000, // Ascii = ["]
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  0x0000,0x0000,0x0000,0x0000,0x1E1C,0x3F1C,0x779C,0x73DC,0x71F8,0x70F0,0x0000,0x0000,0x0000,0x0000,0x0000,0x0000,0x0000,0x0000,0x0000,0x0000,0x0000,0x0000,0x0000,0x0000,0x0000,0x0000,0x0000,0x0000,0x0000,0x0000,0x0000,0x0000, // Ascii = [~]
};
// clang-format on

// clang-format off
static const uint8_t font_small[] = {
  0x00,0x00,0x00,0x00,0x00,0x00,0x00,0x00,0x00,0x00,0x00,0x00,0x00,0x00, // Ascii = [ ]
  0x00,0x00,0x10,0x10,0x10,0x10,0x10,0x10,0x10,0x00,0x10,0x10,0x00,0x00, // Ascii = [!]
  0x00,0x24,0x24,0x24,0x00,0x00,0x00,0x00,0x00,0x00,0x00,0x00,0x00,0x00, // Ascii = ["]
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  0x00,0x62,0x92,0x8C,0x00,0x00,0x00,0x00,0x00,0x00,0x00,0x00,0x00,0x00, // Ascii = [~]
};
// clang-format on




// Send a byte to the command register
static HAL_StatusTypeDef screen_write_command(uint8_t byte) {
  return HAL_I2C_Mem_Write(&I2C_PORT, I2C_ADDR, 0x00, 1, &byte, 1,
          HAL_MAX_DELAY);
}

// Send data
static HAL_StatusTypeDef screen_write_data(uint8_t *buffer, size_t buff_size) {
  return HAL_I2C_Mem_Write(&I2C_PORT, I2C_ADDR, 0x40, 1, buffer,
          buff_size, HAL_MAX_DELAY);
}

void screen_init() {
  // Wait for the screen to boot
  HAL_Delay(100);

  // Init OLED
  screen_write_command(0xAE); //--turn off SSD1306 panel

  screen_write_command(0x20); //Set Memory Addressing Mode
  screen_write_command(0x00); // 00b,Horizontal Addressing Mode; 01b,Vertical Addressing Mode;
  // 10b,Page Addressing Mode (RESET); 11b,Invalid

  screen_write_command(0xB0); //Set Page Start Address for Page Addressing Mode,0-7

  screen_write_command(0xC8); //Set COM Output Scan Direction

  screen_write_command(0x00); //---set low column address
  screen_write_command(0x10); //---set high column address

  screen_write_command(0x40); //--set start line address - CHECK

  screen_write_command(0xA1); //--set segment re-map 0 to 127 - CHECK

  screen_write_command(0xA6); //--set normal color

  screen_write_command(0xA8); //--set multiplex ratio(1 to 64) - CHECK

  screen_write_command(0x1F); //

  screen_write_command(0xA4); //0xa4,Output follows RAM content;0xa5,Output ignores RAM content

  screen_write_command(0xD3); //-set display offset - CHECK
  screen_write_command(0x00); //-not offset

  screen_write_command(0xD5); //--set display clock divide ratio/oscillator frequency
  screen_write_command(0xF0); //--set divide ratio

  screen_write_command(0xD9); //--set pre-charge period
  screen_write_command(0x22); //

  screen_write_command(0xDA); //--set com pins hardware configuration - CHECK
  screen_write_command(0x02);

  screen_write_command(0xDB); //--set vcomh
  screen_write_command(0x20); //0x20,0.77xVcc

  screen_write_command(0x8D); //--set DC-DC enable
  screen_write_command(0x14); //

  screen_write_command(0xAF); //--turn on SSD1306 panel

  // Clear screen
  screen_clear();

  // Flush buffer to screen
  screen_update();
}

/* Fill the whole screen with the given color */
void screen_clear() {
  memset(frame_buffer, 0x00, sizeof(frame_buffer));
}

/* Write the screenbuffer with changed to the screen */
HAL_StatusTypeDef screen_update() {
  // Write data to each page of RAM. Number of pages
  // depends on the screen height:
  //
  //  * 32px   ==  4 pages
  //  * 64px   ==  8 pages
  //  * 128px  ==  16 pages
  for (uint8_t i = 0; i < SCREEN_HEIGHT / 8; i++) {
    if (screen_write_command(0xB0 + i) != HAL_OK || // Set the current RAM page address.
            screen_write_command(0x00) != HAL_OK ||
            screen_write_command(0x10) != HAL_OK ||
            screen_write_data(&frame_buffer[SCREEN_WIDTH * i], SCREEN_WIDTH) != HAL_OK) {
      return HAL_ERROR;
    }
  }
  return HAL_OK;
}

/*
 * Draw one pixel in the screenbuffer
 * X => X Coordinate
 * Y => Y Coordinate
 * color => Pixel color
 */
void screen_draw_pixel(uint8_t x, uint8_t y) {
  if (x >= SCREEN_WIDTH || y >= SCREEN_HEIGHT) {
    // Don't write outside the buffer
    return;
  }

  frame_buffer[x + (y / 8) * SCREEN_WIDTH] |= 1 << (y % 8);
}

/* Draw a string of big glyphs (values) starting at column x */
static void draw_string_big(const char *str, uint16_t x) {
  for (; *str; str++, x += FONT_WIDTH) {
    char ch = *str;
    if (ch < 32 || ch > 126)
      continue;
    for (uint8_t r = 0; r < FONT_HEIGHT; r++) {
      uint16_t bits = font[(ch - 32) * FONT_HEIGHT + r];
      for (uint8_t c = 0; c < FONT_WIDTH; c++) {
        if ((bits << c) & 0x8000) {
          screen_draw_pixel(x + c, BIG_TOP_Y + r);
        }
      }
    }
  }
}

/* Draw a string of small glyphs (units) starting at column x */
static void draw_string_small(const char *str, uint16_t x) {
  for (; *str; str++, x += SMALL_WIDTH) {
    char ch = *str;
    if (ch < 32 || ch > 126)
      continue;
    for (uint8_t r = 0; r < SMALL_HEIGHT; r++) {
      uint8_t bits = font_small[(ch - 32) * SMALL_HEIGHT + r];
      for (uint8_t c = 0; c < SMALL_WIDTH; c++) {
        if ((bits << c) & 0x80) {
          screen_draw_pixel(x + c, SMALL_TOP_Y + r);
        }
      }
    }
  }
}

/* Render a right-justified line: the value in big glyphs and, if given, the
 * unit ("km/h", "km", ...) in small glyphs sharing the big baseline. Flushes
 * only when the value or unit differs from what is on screen (cheap to call
 * every loop pass). The caches update only after a successful flush, so a
 * failed I2C write retries on the next call. Value <= 7 chars, unit <= 4. */
void screen_show_value(const char *value, const char *unit) {
  bool unit_same = unit ? strcmp(unit, on_screen_unit) == 0 : on_screen_unit[0] == '\0';
  if (strcmp(value, on_screen_value) == 0 && unit_same) {
    return;
  }

  screen_clear();
  uint16_t unit_w = unit ? strlen(unit) * SMALL_WIDTH : 0;
  uint16_t x = SCREEN_WIDTH - (strlen(value) * FONT_WIDTH + unit_w);
  draw_string_big(value, x);
  if (unit) {
    draw_string_small(unit, x + strlen(value) * FONT_WIDTH);
  }

  if (screen_update() == HAL_OK) {
    strcpy(on_screen_value, value);
    if (unit) {
      strcpy(on_screen_unit, unit);
    } else {
      on_screen_unit[0] = '\0';
    }
  }
}

/* Initialize the oled screen */
