#include <math.h>
#include <screen.h>
#include <stdlib.h>
#include <string.h>
#include "stm32f1xx_hal.h"
#include "i2c.h"

#define I2C_PORT      hi2c1
#define I2C_ADDR      (0x3C << 1)
#define FONT_WIDTH    16
#define FONT_HEIGHT   26
#define SCREEN_WIDTH  128
#define SCREEN_HEIGHT 32
#define BUFFER_SIZE   (SCREEN_WIDTH * SCREEN_HEIGHT / 8)

static uint8_t buffer[BUFFER_SIZE];

uint32_t x = 0;
uint32_t y = SCREEN_HEIGHT - FONT_HEIGHT;

// clang-format off
const uint16_t font[] = {
  0x0000,0x0000,0x0000,0x0000,0x0000,0x0000,0x0000,0x0000,0x0000,0x0000,0x0000,0x0000,0x0000,0x0000,0x0000,0x0000,0x0000,0x0000,0x0000,0x0000,0x0000,0x0000,0x0000,0x0000,0x0000,0x0000, // Ascii = [ ]
  0x03E0,0x03E0,0x03E0,0x03E0,0x03E0,0x03E0,0x03E0,0x03E0,0x03C0,0x03C0,0x01C0,0x01C0,0x01C0,0x01C0,0x01C0,0x0000,0x0000,0x0000,0x03E0,0x03E0,0x03E0,0x0000,0x0000,0x0000,0x0000,0x0000, // Ascii = [!]
  0x1E3C,0x1E3C,0x1E3C,0x1E3C,0x1E3C,0x1E3C,0x1E3C,0x0000,0x0000,0x0000,0x0000,0x0000,0x0000,0x0000,0x0000,0x0000,0x0000,0x0000,0x0000,0x0000,0x0000,0x0000,0x0000,0x0000,0x0000,0x0000, // Ascii = ["]
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  0x0000,0x0000,0x0000,0x0000,0x0000,0x0000,0x0000,0x0000,0x0000,0x0000,0x0000,0x3F07,0x7FC7,0x73E7,0xF1FF,0xF07E,0x0000,0x0000,0x0000,0x0000,0x0000,0x0000,0x0000,0x0000,0x0000,0x0000, // Ascii = [~]
};
// clang-format on

// Send a byte to the command register
void writeCommand(uint8_t byte) {
  HAL_I2C_Mem_Write(&I2C_PORT, I2C_ADDR, 0x00, 1, &byte, 1,
          HAL_MAX_DELAY);
}

// Send data
void writeData(uint8_t *buffer, size_t buff_size) {
  HAL_I2C_Mem_Write(&I2C_PORT, I2C_ADDR, 0x40, 1, buffer,
          buff_size, HAL_MAX_DELAY);
}

/* Initialize the oled screen */
void initScreen() {
  // Wait for the screen to boot
  HAL_Delay(100);

  // Init OLED
  writeCommand(0xAE); //--turn off SSD1306 panel

  writeCommand(0x20); //Set Memory Addressing Mode
  writeCommand(0x00); // 00b,Horizontal Addressing Mode; 01b,Vertical Addressing Mode;
  // 10b,Page Addressing Mode (RESET); 11b,Invalid

  writeCommand(0xB0); //Set Page Start Address for Page Addressing Mode,0-7

  writeCommand(0xC8); //Set COM Output Scan Direction

  writeCommand(0x00); //---set low column address
  writeCommand(0x10); //---set high column address

  writeCommand(0x40); //--set start line address - CHECK

  writeCommand(0xA1); //--set segment re-map 0 to 127 - CHECK

  writeCommand(0xA6); //--set normal color

  writeCommand(0xA8); //--set multiplex ratio(1 to 64) - CHECK

  writeCommand(0x1F); //

  writeCommand(0xA4); //0xa4,Output follows RAM content;0xa5,Output ignores RAM content

  writeCommand(0xD3); //-set display offset - CHECK
  writeCommand(0x00); //-not offset

  writeCommand(0xD5); //--set display clock divide ratio/oscillator frequency
  writeCommand(0xF0); //--set divide ratio

  writeCommand(0xD9); //--set pre-charge period
  writeCommand(0x22); //

  writeCommand(0xDA); //--set com pins hardware configuration - CHECK
  writeCommand(0x02);

  writeCommand(0xDB); //--set vcomh
  writeCommand(0x20); //0x20,0.77xVcc

  writeCommand(0x8D); //--set DC-DC enable
  writeCommand(0x14); //

  writeCommand(0xAF); //--turn on SSD1306 panel

  // Clear screen
  clearScreen();

  // Flush buffer to screen
  updateScreen();
}

/* Fill the whole screen with the given color */
void clearScreen() {
  memset(buffer, 0x00, sizeof(buffer));
}

/* Write the screenbuffer with changed to the screen */
void updateScreen() {
  // Write data to each page of RAM. Number of pages
  // depends on the screen height:
  //
  //  * 32px   ==  4 pages
  //  * 64px   ==  8 pages
  //  * 128px  ==  16 pages
  for (uint8_t i = 0; i < SCREEN_HEIGHT / 8; i++) {
    writeCommand(0xB0 + i); // Set the current RAM page address.
    writeCommand(0x00);
    writeCommand(0x10);
    writeData(&buffer[SCREEN_WIDTH * i], SCREEN_WIDTH);
  }
}

/*
 * Draw one pixel in the screenbuffer
 * X => X Coordinate
 * Y => Y Coordinate
 * color => Pixel color
 */
void drawPixel(uint8_t x, uint8_t y) {
  if (x >= SCREEN_WIDTH || y >= SCREEN_HEIGHT) {
    // Don't write outside the buffer
    return;
  }

  buffer[x + (y / 8) * SCREEN_WIDTH] |= 1 << (y % 8);
}

/*
 * Draw 1 char to the screen buffer
 * ch       => char om weg te schrijven
 * color    => Black or White
 */
void drawCharacter(char ch) {
  uint32_t i, b, j;

  // Check if character is valid
  if (ch < 32 || ch > 126)
    return;

  // Check remaining space on current line
  if (SCREEN_WIDTH < (x + FONT_WIDTH) || SCREEN_HEIGHT < (y + FONT_HEIGHT)) {
    // Not enough space on current line
    return;
  }

  // Use the font to write
  for (i = 0; i < FONT_HEIGHT; i++) {
    b = font[(ch - 32) * FONT_HEIGHT + i];
    for (j = 0; j < FONT_WIDTH; j++) {
      if ((b << j) & 0x8000) {
        drawPixel(x + j, (y + i));
      }
    }
  }

  // The current space is now taken
  x += FONT_WIDTH;
}

/* Write full string to screenbuffer */
void displayString(char *str) {
  x = 0;

  while (*str) {
    drawCharacter(*str);
    str++;
  }
}
